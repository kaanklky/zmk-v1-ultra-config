## config/west.yml
```yaml
manifest:
  remotes:
    - name: keychron
      url-base: https://github.com/Keychron
  projects:
    - name: zmk
      remote: keychron
      revision: 7f8d16732a3782e237915bff30a1f67de09268b7
    - name: zephyr
      remote: keychron
      revision: 2c11634850f7d6b04e55a253d4506a6e7c8bd673
      clone-depth: 1
      import:
        name-blocklist:
          - ci-tools
          - hal_altera
          - hal_cypress
          - hal_infineon
          - hal_microchip
          - hal_nxp
          - hal_openisa
          - hal_silabs
          - hal_xtensa
          - hal_st
          - hal_ti
          - hal_ambiq
          - hal_atmel
          - hal_espressif
          - hal_ethos_u
          - hal_gigadevice
          - hal_intel
          - hal_nordic
          - hal_nuvoton
          - hal_quicklogic
          - hal_renesas
          - hal_rpi_pico
          - hal_telink
          - hal_wurthelektronik
          - hal_stm32
          - cmsis-dsp
          - cmsis-nn
          - fatfs
          - loramac-node
          - mcuboot
          - mcumgr
          - net-tools
          - openthread
          - edtt
          - trusted-firmware-m
    - name: hal_realtek
      remote: keychron
      revision: 3c8e0bf787d80bc98c0fe4041f660ee1bf091206
      path: modules/hal/realtek
      groups:
        - hal
  self:
    path: config
```

## zmk-key-loop/Kconfig
```kconfig
DT_COMPAT_ZMK_BEHAVIOR_KEY_LOOP := zmk,behavior-key-loop

config ZMK_BEHAVIOR_KEY_LOOP
    bool
    default $(dt_compat_enabled,$(DT_COMPAT_ZMK_BEHAVIOR_KEY_LOOP))
```

## zmk-key-loop/dts/bindings/behaviors/zmk,behavior-key-loop.yaml
```yaml
description: Key loop behavior, presses and releases a key repeatedly until pressed again

compatible: "zmk,behavior-key-loop"

include: one_param.yaml

properties:
  delay-ms:
    type: int
    default: 1
    description: Time in milliseconds between each press and release
```
